## boards/shields/corne_dongle/Kconfig.defconfig
```kconfig
# Corne dongle defaults.
# SPDX-License-Identifier: MIT

if SHIELD_CORNE_DONGLE

config ZMK_KEYBOARD_NAME
    default "Corne"

# This board is the split CENTRAL: it runs the keymap and connects to the host.
config ZMK_SPLIT
    default y

config ZMK_SPLIT_ROLE_CENTRAL
    default y

# Connect to TWO peripherals: the left and right halves.
config ZMK_SPLIT_BLE_CENTRAL_PERIPHERALS
    default 2

# Headroom for the two peripheral links (plus optional BLE hosts).
config BT_MAX_CONN
    default 6

config BT_MAX_PAIRED
    default 6

endif
```

## boards/shields/corne_dongle/Kconfig.shield
```kconfig
# Corne dongle shield — BLE central that talks to both halves and the host.
# SPDX-License-Identifier: MIT

config SHIELD_CORNE_DONGLE
    def_bool $(shields_list_contains,corne_dongle)
```
